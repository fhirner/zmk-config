## boards/shields/lily58/Kconfig.defconfig
```kconfig
if SHIELD_LILY58_DONGLE || SHIELD_LILY58_LEFT || SHIELD_LILY58_RIGHT

config ZMK_SPLIT
    default y

endif # SHIELD_LILY58_DONGLE || SHIELD_LILY58_LEFT || SHIELD_LILY58_RIGHT


if SHIELD_LILY58_DONGLE || SHIELD_LILY58_LEFT

config ZMK_SPLIT_ROLE_CENTRAL
    default y

if ZMK_SPLIT_ROLE_CENTRAL

config ZMK_KEYBOARD_NAME
    default "Lily58"

endif # ZMK_SPLIT_ROLE_CENTRAL

endif # SHIELD_LILY58_DONGLE || SHIELD_LILY58_LEFT


if SHIELD_LILY58_DONGLE

if LVGL

config LV_Z_VDB_SIZE
    default 64

config LV_DPI_DEF
    default 148

config LV_Z_BITS_PER_PIXEL
    default 1

choice LV_COLOR_DEPTH
    default LV_COLOR_DEPTH_1
endchoice

endif # LVGL

endif # SHIELD_LILY58_DONGLE
```
