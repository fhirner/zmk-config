#include "lily58.dtsi"

/ {
    chosen {
        zmk,kscan = &mock_kscan;
    };

    mock_kscan: kscan_1 {
        compatible = "zmk,kscan-mock";
        columns = <0>;
        rows = <0>;
        events = <0>;
    };
};

// FIXME: move these out of the dtsi
/delete-node/ &kscan0;
/delete-node/ &left_encoder;
/delete-node/ &sensors;
